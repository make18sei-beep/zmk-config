## boards/shields/sora46/Kconfig.shield
```kconfig
config SHIELD_SORA46_LEFT
    def_bool $(shields_list_contains,sora46_left)

config SHIELD_SORA46_RIGHT
    def_bool $(shields_list_contains,sora46_right)
```

## boards/shields/sora48/Kconfig.shield
```kconfig
config SHIELD_SORA48_LEFT
    def_bool $(shields_list_contains,sora48_left)

config SHIELD_SORA48_RIGHT
    def_bool $(shields_list_contains,sora48_right)
```

## boards/shields/splitpad/Kconfig.shield
```kconfig
config SHIELD_SPLITPAD_LEFT
    def_bool $(shields_list_contains,splitpad_left)

config SHIELD_SPLITPAD_RIGHT
    def_bool $(shields_list_contains,splitpad_right)
```

## config/west.yml
```yaml
manifest:
  defaults:
    revision: v0.3
  remotes:
    - name: zmkfirmware
      url-base: https://github.com/zmkfirmware
    - name: aym1607
      url-base: https://github.com/AYM1607
  projects:
    - name: zmk
      remote: zmkfirmware
      import: app/west.yml
    # TPS43 (Azoteq IQS572) driver
    - name: zmk-driver-azoteq-iqs5xx
      remote: aym1607
      revision: main
  self:
    path: config
```
